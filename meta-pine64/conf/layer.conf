## meta-pine64/conf/layer.conf
```bitbake
BBPATH .= ":${LAYERDIR}"
BBFILES += "${LAYERDIR}/recipes-*/*/*.bb ${LAYERDIR}/recipes-*/*/*.bbappend"
BBFILE_COLLECTIONS += "pine64"
BBFILE_PATTERN_pine64 = "^${LAYERDIR}/"
BBFILE_PRIORITY_pine64 = "10"
LAYERDEPENDS_pine64 = "core"
LAYERSERIES_COMPAT_pine64 = "scarthgap"
```
